// The event loop around the extracted blocks (sm_* wrappers, generated by run_sm_checks.py) for one side.
// It follows the firmware's order: a poll refreshes the rail, runs the drive region, appends is_parked, runs the
// energy block, buffers the frame and, on a sample poke, sleeps; a ladder event runs the OTA/dump branch, then the backstop, then the state
// change, as handleActivityState().

void enterDeepSleep(bool modem_on, const char* reason) {
  sm_modem_override(modem_on);
  sm_sleep_modem = modem_on;
  if (modem_on) sm_marker();
  if (modem_on && sm_flush_ok) obd_result_vector.clear();  // the pre-sleep flush sent everything
  sm_flush_ok = false;
  sm_marker_clear();
  sm_ble_connected = false;  // bleDeinitForSleep(): the phone goes with the radio
  sm_armed_minutes = g_next_wake_minutes;
  sm_asleep = true;
  sm_sleeps++;
  sm_sleep_reason = reason ? reason : "";
}

struct Snap {
#define SM_FIELD(T, name, value) T name;
  SM_RAM(SM_FIELD) SM_RTC(SM_FIELD) SM_STUB(SM_FIELD) SM_WAKE(SM_FIELD) SM_LOCAL(SM_FIELD)
#undef SM_FIELD
  float gps_speed;
  std::vector<OBDVector> frames;
  // The logs only grow between a snapshot and its restore (only powerOn clears them, and never between the two), so
  // a snapshot keeps their lengths and a restore cuts them back.
  size_t log_n, serial_n;
};

// frames=false skips the copy of the buffered frames, for a snapshot only compared, never restored.
Snap save(bool frames = true) {
  Snap s;
#define SM_SAVE(T, name, value) s.name = name;
  SM_RAM(SM_SAVE) SM_RTC(SM_SAVE) SM_STUB(SM_SAVE) SM_WAKE(SM_SAVE) SM_LOCAL(SM_SAVE)
#undef SM_SAVE
  s.gps_speed = sm_gps.speed;
  if (frames) s.frames = obd_result_vector;
  s.log_n = sm_log.size();
  s.serial_n = sm_serial.size();
  return s;
}

void restore(const Snap& s) {
#define SM_LOAD(T, name, value) name = s.name;
  SM_RAM(SM_LOAD) SM_RTC(SM_LOAD) SM_STUB(SM_LOAD) SM_WAKE(SM_LOAD) SM_LOCAL(SM_LOAD)
#undef SM_LOAD
  sm_gps.speed = s.gps_speed;
  obd_result_vector = s.frames;
  if (sm_log.size() < s.log_n || sm_serial.size() < s.serial_n) {
    fprintf(stderr, "harness: a log shrank between a snapshot and its restore\n");
    abort();
  }
  sm_log.resize(s.log_n);
  sm_serial.resize(s.serial_n);
}

// The fast-cadence budget (#83), checked against the adapter's own record rather than the code that keeps it. The
// firmware judges staleness at a moment inside the block or gate, against evidence the block may stamp, so a reset is
// allowed when the charge could be stale by then, and owed when it was stale before and stayed so.
struct BudgetBefore { uint32_t fast; uint64_t evidence_us, now_us; };
BudgetBefore budgetBefore() { return {charging_fast_minutes, charge_last_evidence_us, esp_rtc_get_time_us()}; }
bool staleAt(uint64_t now_us, uint64_t evidence_us) {
  return now_us < evidence_us || now_us - evidence_us >= (uint64_t)CHARGE_STALE_RESET_MINUTES * 60000000ULL;
}
bool mayBeStale(const BudgetBefore& b) { return staleAt(esp_rtc_get_time_us(), b.evidence_us); }
// A block that stamps evidence makes the charge fresh; one that resets clears the stamp along with the budget.
bool mustBeStale(const BudgetBefore& b) {
  return staleAt(b.now_us, b.evidence_us) && (charge_last_evidence_us == b.evidence_us || !charge_last_evidence_us);
}
bool reasonIs(const char* r) { return g_cadence_reason && !strcmp(g_cadence_reason, r); }
// After the energy block. The charging branch is the one that arms a fast tier with no cadence reason: the follow-up
// and the post-drive window arm WAKE_CHARGING_MINUTES too, past the cap by design (once per charge; POST_DRIVE_*).
void budgetCheck(const BudgetBefore& b, unsigned long energy_ms) {
  const bool charging = !g_cadence_reason &&
    (g_next_wake_minutes == WAKE_CHARGING_MINUTES || g_next_wake_minutes == WAKE_DC_CHARGING_MINUTES);
  const bool released = (!g_cadence_reason && g_next_wake_minutes == WAKE_PARKED_MINUTES) || reasonIs("pdw") ||
                        reasonIs("followup");
  if (charging && b.fast >= (uint32_t)WAKE_CHARGING_MAX_MINUTES)
    sm_budget_broken = "a charging poll armed a fast cadence with the fast budget spent";
  // Only a streaming release or a stale charge resets it: a sample poke's release is a pause in the same charge.
  const bool owed = (released && !g_sample_poke) || ((released || reasonIs("parked-held")) && mustBeStale(b));
  if (b.fast && !charging_fast_minutes && !owed && !mayBeStale(b))
    sm_budget_broken = "a poll reset a budget not yet stale";
  if (owed && charging_fast_minutes) sm_budget_broken = "a streaming release or a stale charge kept its budget";
  // A sample poke, and a streaming wake's first charging poll, add the tier armed; the polls after it add the whole
  // minutes since then (a log line moves the clock 1 ms, so allow one minute either way).
  if (!charging) { sm_run_on = false; return; }
  if (g_sample_poke || !sm_run_on) {
    if (b.fast < (uint32_t)WAKE_CHARGING_MAX_MINUTES && charging_fast_minutes != b.fast + (uint32_t)g_next_wake_minutes)
      sm_budget_broken = "a charging poll did not add the tier it armed";
    sm_run_on = true;
    sm_run_ms = energy_ms;
    sm_run_budget = charging_fast_minutes;
    return;
  }
  const long expected = (long)sm_run_budget + (long)((energy_ms - sm_run_ms) / 60000UL);
  if (std::labs((long)charging_fast_minutes - expected) > 1)
    sm_budget_broken = "a streaming charge's budget does not follow its time on the fast cadence";
}

// The OBD-alarm permit (#83), from the trace's inputs as alarm_gate.h's header states it: on an enforced car, the
// setup window while a phone is authenticated or within ALARM_PERMIT_BLE_GRACE_MS of the last read inside the window
// that saw one (the loop's own presence stamp is not modelled), or the rail awake and either a moving fix no older than
// ALARM_GNSS_MAX_AGE_MS or a speed note at or above ALARM_SPEED_HOLD_KMH within ALARM_SPEED_HOLD_MS. A rail low for
// ALARM_RAIL_COLLAPSE_MS, at the permit's reads, voids the note.
const unsigned long SM_POLL_COMMANDS = 4;  // a poll's PID requests, answered or not
bool alarmOracle() {
  if (g_alarm_flag != 1) return true;
  const bool awake = g_last_io36 >= RAIL_AWAKE_VOLTS;
  if (awake) sm_low_on = false;
  else if (!sm_low_on) sm_low_on = true, sm_low_ms = sm_now;
  if (sm_low_on && sm_now - sm_low_ms >= ALARM_RAIL_COLLAPSE_MS) sm_note_on = false;
  const bool window = sm_setup_on && sm_now < sm_setup_ms;
  if (window && sm_ble_auth) sm_seen_on = true, sm_seen_ms = sm_now;
  if (window && sm_seen_on && sm_now - sm_seen_ms <= ALARM_PERMIT_BLE_GRACE_MS) return true;
  const bool moving = sm_gnss_fresh && sm_fix_age <= ALARM_GNSS_MAX_AGE_MS;
  return awake && (moving || (sm_note_on && sm_now - sm_note_ms < ALARM_SPEED_HOLD_MS));
}
// The car asked exactly when the oracle permits, and the audit trail's shape: every DENY line carries tx=, which never
// moves between two of them. Only the gated branch moves the counter here, so this checks the transition logging.
void alarmCheck(unsigned long tx, bool oracle, size_t log_n) {
  if ((sm_tx != tx) != oracle)
    sm_alarm_broken = oracle ? "a permitted poll did not ask the car" : "a poll asked the car without the permit";
  for (size_t i = log_n; i < sm_log.size(); ++i) {
    const std::string& l = sm_log[i];
    if (l.compare(0, 16, "ALARMGATE PERMIT") == 0) sm_deny_tx = -1;
    if (l.compare(0, 14, "ALARMGATE DENY") != 0) continue;
    const size_t at = l.rfind(" tx=");
    if (at == std::string::npos) { sm_alarm_broken = "a DENY line without tx="; return; }
    const long logged = std::stol(l.substr(at + 4));
    if (sm_deny_tx >= 0 && logged != sm_deny_tx) sm_alarm_broken = "tx= moved between two DENY lines";
    sm_deny_tx = logged;
  }
}

#define SM_RESET(T, name, value) name = value;
// A boot: RAM back to its initialisers, the RTC sanitize and the debt restore, then the setup() gate. A cold boot
// zeroes the clock, as setup() does, until a poll sets it.
void boot(const SmEvent& e, SmReset reset) {
  sm_rtc_ms += sm_now;
  SM_RAM(SM_RESET)
  upload_capped = upload_heap_dropped = 0;
  SM_WAKE(SM_RESET)
  SM_LOCAL(SM_RESET)
  sm_now = 0;
  sm_asleep = false;
  sm_reset = reset;
  if (reset == ESP_RST_DEEPSLEEP) g_wake_reason = e.cause == SM_MOTION ? "MOTION" : "TIMER";
  if (e.cause == SM_COLD) sm_clock_ok = false;
  sm_run_on = false;  // the fast anchor is RAM
  chargeWakeStateSanitize(reset == ESP_RST_DEEPSLEEP);
  sm_restore();
  // A charge latch the trace asserts (a charge some earlier, unmodelled poll saw); otherwise the energy block's own.
  if (e.charge_latched) recently_charging = true;
  g_last_io36 = e.rail;
  sm_atrv = std::isnan(e.atrv) ? (e.awake ? 13.5f : 5.3f) : (float)e.atrv;
  g_alarm_flag = e.alarm ? 1 : -1;
  sm_cold_boot = e.cause == SM_COLD;
  sm_gate_weak = e.rail >= IO36_LOCKOUT_LOW && e.rail < IO36_LOCKOUT_HIGH;
  // The gate runs before the backlog loads: the frames are in the file, RAM is empty. The gate decided to poll
  // when it counted a poll; its skip path sleeps from inside it.
  std::vector<OBDVector> backlog;
  backlog.swap(obd_result_vector);
  sm_backlog_file = !backlog.empty();
  const uint32_t polls = polls_count;
  const BudgetBefore budget = budgetBefore();
  sm_wake_gate(e.cause == SM_COLD ? ESP_SLEEP_WAKEUP_UNDEFINED : e.cause == SM_MOTION ? ESP_SLEEP_WAKEUP_EXT0
                                                                                       : ESP_SLEEP_WAKEUP_TIMER);
  sm_gate_open = polls_count != polls;
  if (budget.fast && !charging_fast_minutes && !mayBeStale(budget)) sm_budget_broken = "a skip wake reset a budget not yet stale";
  if (sm_asleep && !sm_gate_open && budget.fast && charging_fast_minutes && mustBeStale(budget))
    sm_budget_broken = "a skip wake kept a stale charge's budget";
  backlog.swap(obd_result_vector);
  sm_backlog_file = false;
  if (sm_asleep) return;
  sm_stamp();  // after the network bring-up, which a skip never reaches
  changeState(ACTIVE);
}

// A deep-sleep wake keeps RTC. A timer wake slept the armed cadence; a motion wake came sooner, at half of it.
void wake(const SmEvent& e) {
  if (sm_asleep) sm_rtc_ms += (unsigned long)sm_armed_minutes * 60000UL / (e.cause == SM_MOTION ? 2 : 1);
  boot(e, ESP_RST_DEEPSLEEP);
}

// A power loss: the debt store is garbage, which reads as nothing owed.
void powerOn(const SmEvent& e) {
  SM_RTC(SM_RESET)
  SM_STUB(SM_RESET)
  sm_now = 0;
  sm_gps.speed = 0;
  obd_result_vector.clear();
  sm_log.clear();
  sm_serial.clear();
  boot(e, ESP_RST_POWERON);
}

// A panic or WDT reset: the bootloader reloads .rtc.data, the unsent frames in RAM are lost (the worst case:
// the backlog was already loaded), the clock is zeroed until a later poll syncs it (run_sm_checks.py pins that
// line), the debt store is kept. A cold boot, at the rail the wake had.
void crash(SmEvent e, SmReset reset = ESP_RST_PANIC) {
  e.rail = g_last_io36;
  SM_RTC(SM_RESET)
  obd_result_vector.clear();
  sm_clock_ok = false;
  e.cause = SM_COLD;
  boot(e, reset);
}
#undef SM_RESET

// The car's answer, as readPIDs leaves it: nothing when it is silent, else its PIDs in profile order. The
// counters move by the event's steps from where the last poll left them.
OBDVector carFrame(const SmEvent& e) {
  OBDVector frame;
  if (e.silent) return frame;
  if (!std::isnan(e.soc_step)) { sm_soc += e.soc_step; frame.emplace_back("soc", sm_soc); }
  if (e.key == SM_SPEED || e.key == SM_BOTH) frame.emplace_back("speed", e.speed);
  if (e.key == SM_VRS) frame.emplace_back("vehicle_reported_speed", e.speed);
  if (e.key == SM_BOTH) frame.emplace_back("vehicle_reported_speed", e.speed2);
  if (!std::isnan(e.power)) frame.emplace_back("power", e.power);
  if (!std::isnan(e.voltage)) frame.emplace_back("voltage", e.voltage);
  if (!std::isnan(e.current)) frame.emplace_back("current", e.current);
  if (!std::isnan(e.dcfc)) frame.emplace_back("is_dcfc", e.dcfc);
  if (!std::isnan(e.kwh_step)) { sm_kwh += e.kwh_step; frame.emplace_back("kwh_charged", sm_kwh); }
  if (!std::isnan(e.soe_step)) { sm_soe += e.soe_step; frame.emplace_back("soe", sm_soe); }
  return frame;
}

void poll(const SmEvent& e) {
  // The rail the top of the cycle reads: the event's; else for a drive poll the rules' car-on input, and for a
  // charge poll the last one read. Then the GNSS fix, and loop()'s own poll condition (from the tree, for both sides):
  // the weak-rail veto (#104) and the alarm permit. A vetoed or denied cycle reads nothing and runs on as one the car
  // did not answer. An answered poll stamps the last OBD answer, as loop() does. Then the motion stamp and the rolling
  // accumulator.
  if (!std::isnan(e.poll_rail)) g_last_io36 = (float)e.poll_rail;
  else if (e.car != SM_CAR_KEEP) g_last_io36 = e.car == SM_CAR_RAIL ? 13.5f : 12.0f;
  sm_energy_rail();
  sm_gnss_fresh = e.gnss;
  sm_fix_age = e.fix_age_ms;
  const unsigned long tx = sm_tx;
  const size_t log_n = sm_log.size();
  const bool oracle = !g_no_profile && !g_weak_rail_cold_boot && alarmOracle();  // the veto comes first: no gate read
  OBDVector current_frame;
  if (sm_poll_reaches_car()) {
    sm_polls++;
    sm_tx += SM_POLL_COMMANDS;
    current_frame = carFrame(e);
  }
  alarmCheck(tx, oracle, log_n);
  const int obd_count = (int)current_frame.size();
  if (obd_count > 0) g_last_obd_answer_ms = sm_now;
  sm_gps.speed = (float)(e.gnss_kmh / 1.852);
  sm_clock_ok = e.clock_ok;
  if (e.motion == SM_MOVE_NOW) g_last_motion_ms = sm_now;
  else if (e.motion == SM_MOVE_NONE) g_last_motion_ms = 0;
  sm_motion_inputs(e);
  const bool latch = recently_charging;
  recently_charging = e.charge_block;
  sm_drive_poll(current_frame);
  recently_charging = latch;
  sm_emplace(current_frame);
  sm_published = -1;
  for (const auto& res : current_frame) if (res.first == "is_parked") sm_published = res.second;
  const BudgetBefore budget = budgetBefore();
  const unsigned long energy_ms = sm_now;
  sm_energy(current_frame, obd_count);
  budgetCheck(budget, energy_ms);
  sm_buffer(current_frame, e.has_data);
  sm_marker_set();
  sm_weak_recovered();  // the car switched on during a weak-rail cold boot (#104)
  if (!sm_asleep) sm_weak_expiry();  // the device's sleep never returns
  if (sm_asleep) return;
  if (sm_poke_sleeps()) enterDeepSleep(true);  // a poke the DC hold does not keep sleeps after its one poll
}

void ladder(const SmEvent& e) {
  g_ota_active = e.k == SmKind::HOLD && !e.dump;
  g_logdump_active = e.k == SmKind::HOLD && e.dump;
  sm_session();
  sm_backstop();
  g_ota_active = g_logdump_active = false;
  if (sm_asleep || e.k == SmKind::HOLD) return;
  switch (e.to) {
  case SmTo::ACTIVE: changeState(ACTIVE); break;
  case SmTo::BLE: changeState(BLE); break;
  case SmTo::CHARGING: changeState(CHARGING); break;
  case SmTo::STANDBY: changeState(STANDBY); break;
  }
}

void step(const SmEvent& e) {
  switch (e.k) {
  case SmKind::ADVANCE: sm_now += e.ms; return;
  case SmKind::WAKE: wake(e); return;
  default: break;
  }
  if (sm_asleep) return;  // nothing runs between a sleep and the next wake
  switch (e.k) {
  case SmKind::POLL: poll(e); break;
  case SmKind::MAINT: maintenance_mode = e.on; break;
  case SmKind::SETUP:  // a completed full profile push from an authenticated phone, or (off) the phone leaving
    sm_ble_auth = e.on;
    if (!e.on) break;
    sm_setup_on = true;
    sm_setup_ms = sm_now + (unsigned long)ALARM_SETUP_PERMIT_MINUTES * 60000UL;
    alarmGrantSetupPermit();
    break;
  case SmKind::LADDER: case SmKind::HOLD: ladder(e); break;
  case SmKind::SLEEP:
    sm_clock_ok = e.clock_ok;
    if (e.crash) {  // a panic in the pre-sleep flush, after the marker block (#30's field crashes)
      bool modem_on = e.modem_on;
      sm_modem_override(modem_on);
      if (modem_on) sm_marker();
      crash(e, ESP_RST_TASK_WDT);  // a hung upload
      break;
    }
    sm_flush_ok = e.sent;
    pdwArmAtLadderEnd();  // every ladder sleep arms the post-drive window first
    enterDeepSleep(e.modem_on, e.reason);
    break;
  case SmKind::CRASH: crash(e); break;
  default: break;
  }
}

// Properties of one side after event e, against its state before it. Null when they hold.
const char* propertyBroken(const Snap& pre, const SmEvent& e) {
  if (sm_budget_broken) return sm_budget_broken;
  if (sm_alarm_broken) return sm_alarm_broken;
  if (e.k == SmKind::WAKE && sm_gate_weak && sm_gate_open) return "the gate opened on a weak rail";
  // A weak-rail cold boot stays up for BLE, but its loop's poll condition vetoes every cycle (#104), so no wake on a
  // weak rail asks the car anything.
  if (sm_gate_weak && sm_polls != pre.sm_polls) return "a poll ran on a weak-rail wake";
  if (g_weak_rail_cold_boot && !sm_cold_boot) return "the weak-rail BLE window opened on a deep-sleep wake";
  if (!pre.sm_asleep && sm_asleep && pre.g_weak_rail_cold_boot && sm_sleep_modem)
    return "a weak-rail cold boot slept with the modem on (marker, flush)";
  // The backstop runs at the top of a ladder tick, so the state it judges is the one before the tick.
  if (e.k == SmKind::LADDER && !pre.sm_asleep && pre.is_currently_parked && !pre.maintenance_mode &&
      pre.current_state != UNINITIALIZED && sm_now > (unsigned long)MAX_AWAKE_MINUTES * 60UL * 1000UL &&
      !(sm_asleep && sm_sleep_reason == "backstop"))
    return "awake past MAX_AWAKE_MINUTES while parked, and the next ladder tick did not take the backstop sleep";
  // The backstop is shared context but reads the latch: it must never take a driving car to sleep.
  if (e.k == SmKind::LADDER && !pre.sm_asleep && !pre.is_currently_parked && sm_asleep && sm_sleep_reason == "backstop")
    return "the backstop slept while driving";
  const bool crashed = !pre.sm_asleep && (e.k == SmKind::CRASH || (e.k == SmKind::SLEEP && e.crash));
  bool marker_buffered = false;
  for (const auto& frame : pre.frames) marker_buffered |= frame.size() == 2 && frame[0].first == "is_parked";
  if (crashed && (pre.park_marker_owed || marker_buffered) && !park_marker_owed)
    return "a crash lost the trip-end marker debt";
  size_t unlatch_lines = 0;
  for (size_t i = pre.log_n; i < sm_log.size(); ++i) {
    if (sm_log[i].size() > 119) return "a logEvent line is longer than the 119 characters logEvent keeps";
    unlatch_lines += sm_log[i].compare(0, 13, "LEASH driving") == 0;
  }
  if (e.k == SmKind::WAKE || crashed) return nullptr;  // a boot resets the latch to its initialiser, by design
  const unsigned freezes = sm_freezes - pre.sm_freezes;
  if (pre.is_currently_parked && !is_currently_parked && unlatch_lines != 1) return "an unlatch without exactly one LEASH line";
  if (!pre.is_currently_parked && is_currently_parked && freezes != 1) return "a re-latch without exactly one freeze";
  if (pre.is_currently_parked == is_currently_parked && (unlatch_lines || freezes)) return "a LEASH line or freeze without a flip";
  return nullptr;
}
